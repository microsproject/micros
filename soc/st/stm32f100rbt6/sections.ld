/*--------------------------------------------------------------------------------------------------------------------*/
/* SPDX-License-Identifier: MIT */
/*--------------------------------------------------------------------------------------------------------------------*/
MEMORY {
  FLASH (rx)  : ORIGIN = 0x08000000, LENGTH = 128K
  RAM  (rwx) : ORIGIN = 0x20000000, LENGTH = 8K
}
/*--------------------------------------------------------------------------------------------------------------------*/
__STACK_SIZE = 0x0800; /* 2KB */
__HEAP_SIZE  = 0x0800; /* 2KB */
/*--------------------------------------------------------------------------------------------------------------------*/
